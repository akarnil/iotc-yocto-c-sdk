## meta-myExampleIotconnectLayer/conf/layer.conf
```bitbake
# We have a conf and classes directory, add to BBPATH
BBPATH .= ":${LAYERDIR}"

# We have recipes-* directories, add to BBFILES
BBFILES += "${LAYERDIR}/recipes-*/*/*.bb \
            ${LAYERDIR}/recipes-*/*/*.bbappend"

BBFILE_COLLECTIONS += "meta-myExampleIotconnectLayer"
BBFILE_PATTERN_meta-myExampleIotconnectLayer = "^${LAYERDIR}/"
BBFILE_PRIORITY_meta-myExampleIotconnectLayer = "7"

LAYERDEPENDS_myExampleIotconnectLayer = "core"
LAYERSERIES_COMPAT_meta-myExampleIotconnectLayer = "kirkstone"

# If you are building a "core" image (ie core-image-base) then you must use CORE_IMAGE_EXTRA_INSTALL
# to add the application otherwise comment the line below out

CORE_IMAGE_EXTRA_INSTALL += " iotc-c-telemetry-demo-dev"


# If you are building a customised non "core" image then you must use IMAGE_INSTALL
#  to add the application otherwise comment the line below out

# IMAGE_INSTALL += " iotc-c-telemetry-demo-dev"
```
